## arch/arm/cpu/armv7/infinity6/Kconfig
```kconfig
if INFINITY6

config SYS_CONFIG_NAME
    default "infinity6"
    ---help---
    To load the "include/configs/infinity6.h"


config SYS_SOC
    default "infinity6"
    ---help---
    To generate correct  "arch/arm/include/asm/arch"

config SYS_GENERIC_BOARD
    bool
    default y

config VERSION_FPGA
    bool "FPGA version"
    default n

config SS_BOOTING_PERF
    bool "booting time"
    default y

config SSTAR_SPL_EARLY_BSS
    bool "clear bss section first before run board_f"
    default n
endif
```

## arch/arm/cpu/armv7/infinity6c/Kconfig
```kconfig
if INFINITY6C

config SYS_CONFIG_NAME
    default "infinity6c"
    ---help---
    To load the "include/configs/infinity6c.h"


config SYS_SOC
    default "infinity6c"
    ---help---
    To generate correct  "arch/arm/include/asm/arch"

config SYS_GENERIC_BOARD
    bool
    default y

config VERSION_FPGA
    bool "FPGA version"
    default n

config SS_BOOTING_PERF
    bool "booting time"
    default y

config SSTAR_SPL_EARLY_BSS
    bool "clear bss section first before run board_f"
    default n

config VERSION_PZ1
    bool "Palladium version"
    default n
endif
```

## arch/arm/cpu/armv7/infinity6e/Kconfig
```kconfig
if INFINITY6E

config SYS_CONFIG_NAME
    default "infinity6e"
    ---help---
    To load the "include/configs/infinity6e.h"


config SYS_SOC
    default "infinity6e"
    ---help---
    To generate correct  "arch/arm/include/asm/arch"

config SYS_GENERIC_BOARD
    bool
    default y

config VERSION_FPGA
    bool "FPGA version"
    default n

config SS_BOOTING_PERF
    bool "booting time"
    default y

config SSTAR_SPL_EARLY_BSS
    bool "clear bss section first before run board_f"
    default n
endif
```

## arch/arm/cpu/armv7/mercury6/Kconfig
```kconfig
if MERCURY6

config SYS_CONFIG_NAME
    default "mercury6"
    ---help---
    To load the "include/configs/mercury6.h"


config SYS_SOC
    default "mercury6"
    ---help---
    To generate correct  "arch/arm/include/asm/arch"

config SYS_GENERIC_BOARD
    bool
    default y

config VERSION_FPGA
    bool "FPGA version"
    default n

config SS_BOOTING_PERF
    bool "booting time"
    default y

config SSTAR_SPL_EARLY_BSS
    bool "clear bss section first before run board_f"
    default n
endif
```

## arch/arm/cpu/armv7/mercury6p/Kconfig
```kconfig
if MERCURY6P

config SYS_CONFIG_NAME
    default "mercury6p"
    ---help---
    To load the "include/configs/mercury6p.h"


config SYS_SOC
    default "mercury6p"
    ---help---
    To generate correct  "arch/arm/include/asm/arch"

config SYS_GENERIC_BOARD
    bool
    default y

config VERSION_FPGA
    bool "FPGA version"
    default n

config SS_BOOTING_PERF
    bool "booting time"
    default y

config SSTAR_SPL_EARLY_BSS
    bool "clear bss section first before run board_f"
    default n

config SS_SWITCH_AARCH64
    bool "switch_aarch64"
    default y

config SS_SMF_LOAD_64_KERNEL_ENTRY
    bool "smf load 64bit kernel-entry"
    select SS_SWITCH_AARCH64
    default n

config VERSION_PZ1
    bool "Palladium version"
    default n
    ---help---
    This will disable some board settings.
    And it will enable the system DCache to speed up kernel loading.
config USE_ARCH_MEMSET
    bool "Use arm's memset"
    default n
    ---help---
    Use arm  memset implementation install of C lib.
endif

config USE_TOOLCHAIN_DEFAULT_FLOAT_ABI
    bool "Use toolchain default float ABI"
    default n
    ---help---
    Enable uboot to use the same float ABI as toolchain
```

## common/Kconfig
```kconfig
menu "Command line interface"
	depends on !SPL_BUILD

config HUSH_PARSER
	bool "Use hush shell"
	select SYS_HUSH_PARSER
	help
	  This option enables the "hush" shell (from Busybox) as command line
	  interpreter, thus enabling powerful command line syntax like
	  if...then...else...fi conditionals or `&&' and '||'
	  constructs ("shell scripts").

	  If disabled, you get the old, much simpler behaviour with a somewhat
	  smaller memory footprint.

config SYS_HUSH_PARSER
	bool
	help
	  Backward compatibility.

comment "Commands"

menu "Info commands"

config CMD_BDI
	bool "bdinfo"
	help
	  Print board info

config CMD_CONSOLE
	bool "coninfo"
	help
	  Print console devices and information.

config CMD_LICENSE
	bool "license"
	help
	  Print GPL license text

endmenu

menu "Boot commands"

config CMD_BOOTD
	bool "bootd"
	help
	  Run the command stored in the environment "bootcmd", i.e.
	  "bootd" does the same thing as "run bootcmd".

config CMD_BOOTM
	bool "bootm"
	default y
	help
	  Boot an application image from the memory.

config CMD_BOOTMC1
	bool "bootmc1"
	default n
	help
	  Test bootm for core1.

config CMD_GO
	bool "go"
	default y
	help
	  Start an application at a given address.

config CMD_RUN
	bool "run"
	help
	  Run the command in the given environment variable.

config CMD_IMI
	bool "iminfo"
	help
	  Print header information for application image.

config CMD_IMLS
	bool "imls"
	help
	  List all images found in flash

config CMD_XIMG
	bool "imxtract"
	help
	  Extract a part of a multi-image.

endmenu

menu "Environment commands"

config CMD_EXPORTENV
	bool "env export"
	default y
	help
	  Export environments.

config CMD_IMPORTENV
	bool "env import"
	default y
	help
	  Import environments.

config CMD_EDITENV
	bool "editenv"
	help
	  Edit environment variable.

config CMD_SAVEENV
	bool "saveenv"
	help
	  Run the command in the given environment variable.

endmenu

menu "Memory commands"

config CMD_MEMORY
	bool "md, mm, nm, mw, cp, cmp, base, loop"
	help
	  Memeory commands.
	    md - memory display
	    mm - memory modify (auto-incrementing address)
	    nm - memory modify (constant address)
	    mw - memory write (fill)
	    cp - memory copy
	    cmp - memory compare
	    base - print or set address offset
	    loop - initinite loop on address range

config CMD_CRC32
	bool "crc32"
	default y
	help
	  Compute CRC32.

config LOOPW
	bool "loopw"
	help
	  Infinite write loop on address range

config CMD_MEMTEST
	bool "crc32"
	help
	  Simple RAM read/write test.

config CMD_MX_CYCLIC
	bool "mdc, mwc"
	help
	  mdc - memory display cyclic
	  mwc - memory write cyclic

config CMD_MEMINFO
	bool "meminfo"
	help
	  Display memory information.

endmenu

menu "Device access commands"

config CMD_LOADB
	bool "loadb"
	help
	  Load a binary file over serial line.

config CMD_LOADS
	bool "loads"
	help
	  Load an S-Record file over serial line

config CMD_FLASH
	bool "flinfo, erase, protect"
	help
	  NOR flash support.
	    flinfo - print FLASH memory information
	    erase - FLASH memory
	    protect - enable or disable FLASH write protection

config CMD_NAND
	bool "nand"
	help
	  NAND support.

config CMD_SPI
	bool "mspi"
	help
	  SPI utility command.

config CMD_I2C
	bool "i2c"
	help
	  I2C support.

config CMD_SAR
	bool "sar"
	help
	  SAR support.

config CMD_BOOTLOGO
	bool "bootlogo"
	help
	  bootlog support.

config CMD_BOOTMUSIC
	bool "bootmusic"
    select SSTAR_AIO
	help
	  bootmusic support.

config CMD_CAMDRIVER
	bool "camdriver"
	help
		camdrvier test support.

config CMD_USB
	bool "usb"
	help
	  USB support.

config CMD_FPGA
	bool "fpga"
	help
	  FPGA support.

endmenu


menu "Shell scripting commands"

config CMD_ECHO
	bool "echo"
	help
	  Echo args to console

config CMD_ITEST
	bool "itest"
	help
	  Return true/false on integer compare.

config CMD_SOURCE
	bool "source"
	help
	  Run script from memory

endmenu

menu "Network commands"

config CMD_NET
	bool "bootp, tftpboot"
	help
	  Network commands.
	  bootp - boot image via network using BOOTP/TFTP protocol
	  tftpboot - boot image via network using TFTP protocol

config CMD_TFTPPUT
	bool "tftp put"
	help
	  TFTP put command, for uploading files to a server

config CMD_TFTPSRV
	bool "tftpsrv"
	help
	  Act as a TFTP server and boot the first received file

config CMD_RARP
	bool "rarpboot"
	help
	  Boot image via network using RARP/TFTP protocol

config CMD_DHCP
	bool "dhcp"
	help
	  Boot image via network using DHCP/TFTP protocol

config CMD_NFS
	bool "nfs"
	help
	  Boot image via network using NFS protocol.

config CMD_PING
	bool "ping"
	help
	  Send ICMP ECHO_REQUEST to network host

config CMD_CDP
	bool "cdp"
	help
	  Perform CDP network configuration

config CMD_SNTP
	bool "sntp"
	help
	  Synchronize RTC via network

config CMD_DNS
	bool "dns"
	help
	  Lookup the IP of a hostname

config CMD_LINK_LOCAL
	bool "linklocal"
	help
	  Acquire a network IP address using the link-local protocol

config CMD_NETUPGRADE
	bool "netupgrade"
	help
	  Auto Net upgrade on booting

endmenu

menu "USB commands"
config CMD_FASTBOOT
	bool "fastboot"
	help
	  This enables the command fastboot which enables the Android
	  fastboot mode for the platform USB device. Fastboot is a USB
	  protocol for downloading images, flashing and device control
	  used on Android devices.
config CMD_DFU
	bool "dfu"
	help
	  This enables the command dfu which enables the Device Firmware
 	  Upgrade mode for the platform USB device.
config CMD_USBSTART
	bool "usbstart"
	help
	  Hook usb ether to ETHERNET
config CMD_USB_MASS_STORAGE
	bool "UMS usb mass storage"
	select USB_GADGET_MASS_STORAGE
	select USBDOWNLOAD_GADGET
	help
	  USB mass storage support
config CMD_SSTAR_UFU
	bool "UFU sigmastar usb firmware update"
	select USB_GADGET_FIRMWARE_UPDATE
	select SSTAR_DNL_GADGET
	help
	  USB firmware update support
config AUTOBOOT_CMD_UFU
	bool "Auto run ufu command in boot"
	depends on CMD_SSTAR_UFU
config USB_GADGET_MSB250X
	def_bool y if CMD_FASTBOOT || CMD_USBSTART || CMD_USB_MASS_STORAGE || CMD_DFU || CMD_SSTAR_UFU
config USB_GADGET
	def_bool y if USB_GADGET_MSB250X
config USBDOWNLOAD_GADGET
	def_bool y if CMD_FASTBOOT
	def_bool y if CMD_DFU
config USB_ETHER
	def_bool y if CMD_USBSTART
config USB_ETH_CDC
	def_bool y if USB_ETHER
config USB_ETH_RNDIS
	def_bool y if USB_ETHER
config SSTAR_UTMI_POWERON
	bool "Power on UTMI first"
	depends on USB_GADGET_MSB250X
config SSTAR_MSB250X_BULK_OUT_PATCH
	def_bool y if CMD_SSTAR_UFU
	bool "Patch for bulk out incorrect rx length"
	depends on USB_GADGET_MSB250X
endmenu

menu "Misc commands"

config CMD_TIME
	bool "time"
	help
	  Run commands and summarize execution time.

# TODO: rename to CMD_SLEEP
config CMD_MISC
	bool "sleep"
	help
	  Delay execution for some time

config CMD_TIMER
	bool "timer"
	help
	  Access the system timer.

config CMD_SETGETDCR
	bool "getdcr, setdcr, getidcr, setidcr"
	depends on 4xx
	help
	  getdcr - Get an AMCC PPC 4xx DCR's value
	  setdcr - Set an AMCC PPC 4xx DCR's value
	  getidcr - Get a register value via indirect DCR addressing
	  setidcr - Set a register value via indirect DCR addressing

config CMD_OTPCTRL
       bool "otpctrl"
       help
         suppot program/read otp content.

config CMD_OTPBURN
       bool "otpburn"
       help
         suppot auto program otp flow.

config SSTAR_CMD_SPINAND
        bool "spinand"
        help
          Support copy data from the current Flash to another Flash

endmenu
endmenu
config XZ
	bool "XZ"

config MZ
	bool "MZ"

config SS_BOARD_RAMSIZE_MB_16
	bool "Board with 16 MB DDR"
config SS_BOARD_RAMSIZE_MB_48
	bool "Board with 48 MB DDR"
config SS_BOARD_RAMSIZE_MB_64
	bool "Board with 64 MB DDR"
config SS_BOARD_RAMSIZE_MB_80
        bool "Board with 80 MB DDR"

choice
	prompt "RAM chip size"
	default SS_RAMSIZE_MB_16 if SS_BOARD_RAMSIZE_MB_16
	default SS_RAMSIZE_MB_48 if SS_BOARD_RAMSIZE_MB_48
	default SS_RAMSIZE_MB_64 if SS_BOARD_RAMSIZE_MB_64
	default SS_RAMSIZE_MB_80 if SS_BOARD_RAMSIZE_MB_80
	help
	  Select the size of the RAM.

config SS_RAMSIZE_MB_16
	bool "16 MB"
	help
	  Choose this option if you have a 16 MB RAM chip.

config SS_RAMSIZE_MB_48
	bool "48 MB"
	help
	  Choose this option if you have a 48 MB RAM chip.

config SS_RAMSIZE_MB_64
	bool "64 MB"
	help
	  Choose this option if you have a 64 MB RAM chip.

config SS_RAMSIZE_MB_80
	bool "80 MB"
	help
	  Choose this option if you have a 80 MB RAM chip.

endchoice


config SS_RAM_SIZE
	hex
	default 0x01000000 if SS_RAMSIZE_MB_16
	default 0x03000000 if SS_RAMSIZE_MB_48
	default 0x04000000 if SS_RAMSIZE_MB_64
	default 0x05000000 if SS_RAMSIZE_MB_80

config SS_LOAD_ADDR
	hex
	default 0x20D00000 if SS_RAMSIZE_MB_16
	default 0x22D00000 if SS_RAMSIZE_MB_48
	default 0x23D00000 if SS_RAMSIZE_MB_64
	default 0x24D00000 if SS_RAMSIZE_MB_80

config SS_RUN_ADDR
	hex
	default 0x20E00000 if SS_RAMSIZE_MB_16
	default 0x22E00000 if SS_RAMSIZE_MB_48
	default 0x23E00000 if SS_RAMSIZE_MB_64
	default 0x24E00000 if SS_RAMSIZE_MB_80

config SYS_TEXT_BASE
	hex
	default 0x20E00000 if SS_RAMSIZE_MB_16
	default 0x22E00000 if SS_RAMSIZE_MB_48
	default 0x23E00000 if SS_RAMSIZE_MB_64
	default 0x24E00000 if SS_RAMSIZE_MB_80
```

## drivers/dfu/Kconfig
```kconfig
menu "DFU support"

config DFU
	bool

config DFU_FUNCTION
	bool "Enable USB DFU gadget"
	depends on USB_GADGET
	default y if CMD_DFU
	select DFU
	select USBDOWNLOAD_GADGET
	help
	  This enables the USB part of the dfu gadget.

if DFU
config DFU_MMC
	bool "MMC back end for DFU"
	help
	  This option enables using DFU to read and write to MMC based storage.

config DFU_NAND
	bool "NAND back end for DFU"
	depends on CMD_MTDPARTS || MS_SPINAND
	help
	  This option enables using DFU to read and write to NAND based
	  storage.

config DFU_BUF_ADDR
	hex "Define NAND UBI buffer address"
	depends on DFU_NAND
	default 0x21000000 if DFU_NAND

config DFU_RAM
	bool "RAM back end for DFU"
	help
	  This option enables using DFU to read and write RAM on the target.

config DFU_SF
	bool "SPI flash back end for DFU"
	help
	  This option enables using DFU to read and write to SPI flash based
	  storage.

endif
endmenu
```
